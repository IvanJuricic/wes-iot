## esp8266/main/Kconfig.projbuild
```kconfig
menu "Example Configuration"

    config ESP_WIFI_SSID
        string "WiFi SSID"
        default "myssid"
        help
            SSID (network name) for the example to connect to.

    config ESP_WIFI_PASSWORD
        string "WiFi Password"
        default "mypassword"
        help
            WiFi password (WPA or WPA2) for the example to use.
    
    config EXAMPLE_PORT
    int "Port"
    range 0 65535
    default 3333
    help
        Local port the example server will listen on.

endmenu
```
